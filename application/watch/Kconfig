## application/watch/Kconfig
```kconfig
menu "Application Configuration"

rsource "gui/Kconfig"
rsource "testsuite/Kconfig"
endmenu

#zephyr
osource "Kconfig.zephyr"
```

## application/watch/boards/iwatchv0.conf
```kconfig
#use standard KSCAN DRV FOR GUIX
CONFIG_KSCAN=y
CONFIG_KSCAN_CYTTSP5=y
CONFIG_TOUCH_CYTTSP5=n

#it is neccesary for CONFIG_MSPI_APOLLO3P......
CONFIG_APOLLO3P_DEVICE=y
CONFIG_MISC=y

#Montion
CONFIG_MOTION=y


#SPI NOR FLASH MX25U256
CONFIG_MSPI_APOLLO3P=y
CONFIG_APOLLO3P_MSPI1=y
CONFIG_APOLLO_MSPI_NOR=y
CONFIG_MX25U256=y

#about flash
CONFIG_FLASH_MAP=y
CONFIG_FLASH=y
CONFIG_FLASH_PAGE_LAYOUT=y

# iwatchv0 have nor flash, setting use it!
CONFIG_SETTINGS=y
CONFIG_SETTINGS_CUSTOM=y
CONFIG_NVS_CUSTOM=y
CONFIG_SETTING_USE_NVS_CUSTOM=y

#GUIX
CONFIG_GUIX_MEMPOOL_SIZE=10240
CONFIG_GUIX=y
CONFIG_GUI_SPLIT_BINRES=y

#DISPLAY DRV
CONFIG_LCD=y
CONFIG_LCD_RM69092=y

#GUIX APP choice
CONFIG_GUI_APP=y

#clock
CONFIG_POSIX_CLOCK=y

#RTC DRV
CONFIG_APOLLO3P_DEVICE_PRIVATE=y
CONFIG_COUNTER_EXTRA=y
CONFIG_COUNTER_RTC_APOLLO3P=y

CONFIG_NEWLIB_LIBC=y
CONFIG_NEWLIB_LIBC_FLOAT_PRINTF=y
CONFIG_FPU=y
CONFIG_FPU_SHARING=y
CONFIG_FP_HARDABI=y
CONFIG_SENSOR=y
CONFIG_MOTION=y
CONFIG_GH3011=y
#CONFIG_PAH8112=y

#Services
CONFIG_SERVICE=y
CONFIG_MAGNET_SVR=y

CONFIG_EXTRA_EXCEPTION_INFO=y

# Filesystem
CONFIG_FILE_SYSTEM=y
CONFIG_FILE_SYSTEM_LITTLEFS=y
CONFIG_FS_LITTLEFS_PROG_SIZE=256
CONFIG_FS_LITTLEFS_CACHE_SIZE=256
```

## application/watch/build/Kconfig/Kconfig.modules
```kconfig
menu "gui (/home/wt/zephyr-kit/project_wkpace/gui)"
osource "/home/wt/zephyr-kit/project_wkpace/gui/Kconfig"
config ZEPHYR_GUI_MODULE
	bool
	default y
endmenu
menu "subsys (/home/wt/zephyr-kit/project_wkpace/../bsps/subsys)"
osource "/home/wt/zephyr-kit/bsps/subsys/Kconfig"
config ZEPHYR_SUBSYS_MODULE
	bool
	default y
endmenu
menu "testsuite (/home/wt/zephyr-kit/project_wkpace/testsuite)"
osource "/home/wt/zephyr-kit/project_wkpace/testsuite/Kconfig"
config ZEPHYR_TESTSUITE_MODULE
	bool
	default y
endmenu
menu "drivers (/home/wt/zephyr-kit/project_wkpace/../bsps/drivers)"
osource "/home/wt/zephyr-kit/bsps/drivers/zephyr/Kconfig"
config ZEPHYR_DRIVERS_MODULE
	bool
	default y
endmenu
menu "drivers_ext (/home/wt/zephyr-kit/project_wkpace/../bsps/drivers_ext)"
osource "/home/wt/zephyr-kit/bsps/drivers_ext/Kconfig"
config ZEPHYR_DRIVERS_EXT_MODULE
	bool
	default y
endmenu
menu "components (/home/wt/zephyr-kit/project_wkpace/../components)"
osource "/home/wt/zephyr-kit/components/Kconfig"
config ZEPHYR_COMPONENTS_MODULE
	bool
	default y
endmenu
```

## application/watch/build/Kconfig/Kconfig.shield
```kconfig
osource "/home/wt/zephyr-kit/project_wkpace/../bsps/boards/shields/*/Kconfig.shield"
osource "/home/wt/zephyr-kit/zephyr_pkg/zephyr/boards/shields/*/Kconfig.shield"
```

## application/watch/build/Kconfig/Kconfig.shield.defconfig
```kconfig
osource "/home/wt/zephyr-kit/project_wkpace/../bsps/boards/shields/*/Kconfig.defconfig"
osource "/home/wt/zephyr-kit/zephyr_pkg/zephyr/boards/shields/*/Kconfig.defconfig"
```

## application/watch/build/Kconfig/Kconfig.soc
```kconfig
osource "/home/wt/zephyr-kit/project_wkpace/../bsps/soc/$(ARCH)/*/Kconfig.soc"
osource "/home/wt/zephyr-kit/zephyr_pkg/zephyr/soc/$(ARCH)/*/Kconfig.soc"
```

## application/watch/build/Kconfig/Kconfig.soc.arch
```kconfig
osource "/home/wt/zephyr-kit/project_wkpace/../bsps/soc/$(ARCH)/Kconfig"
osource "/home/wt/zephyr-kit/project_wkpace/../bsps/soc/$(ARCH)/*/Kconfig"
osource "/home/wt/zephyr-kit/zephyr_pkg/zephyr/soc/$(ARCH)/Kconfig"
osource "/home/wt/zephyr-kit/zephyr_pkg/zephyr/soc/$(ARCH)/*/Kconfig"
```

## application/watch/gui/Kconfig
```kconfig
menuconfig GUI_APP
	bool "gui app"
	help
	  Enable gui app.

if GUI_APP
choice APP_CHOICE
  prompt "gui app choice"
  default WF_HONBOW

config WF_TEST
	bool "watch face test select"
	help
	  This option select watch face test.

config WF_HONBOW
	bool "honbow app select"
	help
	  This option select honbow app.

config WF_GUIX_DEMO
	bool "guix demo select"
	help
	  This option select guix demo.

endchoice

endif
```

## application/watch/testsuite/Kconfig
```kconfig
# Testsuite


menu "Unit Test" 
config FATFS_TEST
  bool "FAT filesystem test"
  depends on FAT_FILESYSTEM_ELM
  
config GPIO_TEST
  bool "GPIO driver test"
  depends on GPIO
  
config LIS2DH_TEST
  bool "LIS2DH sensor(G-SENSOR) test"

config ADC_TEST
  bool "ADC test"

config ICM42607_TEST
  bool "ICM42607 6D sensor test"
  
rsource "ble/Kconfig"
endmenu
```

## application/watch/testsuite/ble/Kconfig
```kconfig
# BLE Testsuite

menuconfig BLE_UNIT_TEST
  bool "BLE testsuites"
  depends on BT
  
if BLE_UNIT_TEST

choice
prompt "BLE test"

config BLE_HR_TEST
  bool "Heart rate test for BLE"
  
config BLE_PERIPHERAL_TEST
  bool "Peripheral role"

config BLE_SERIAL_TEST
  bool "serial test for BLE"
  depends on BT
  
config BLE_CONSOLE
  bool "Enable BT console"
  select BT_NUS
  
if BLE_SERIAL_TEST
  rsource "Kconfig.serial"
endif

endchoice
endif
```

## rootkit/Kconfig
```kconfig
# RootKit configurations 

rsource "subsys/Kconfig"
rsource "lib/Kconfig"
rsource "init/Kconfig"
rsource "gui/Kconfig"
rsource "debugger/Kconfig"
```

## rootkit/boards/arm/ama3b2evb/Kconfig.board
```kconfig
# APOLLO3P board configuration

config BOARD_AMA3B2EVB
	bool "APOLLO3P AMA3B2EVB"
	depends on SOC_APOLLO3P
```

## rootkit/boards/arm/ama3b2evb/Kconfig.defconfig
```kconfig
# SPDX-License-Identifier: Apache-2.0

if BOARD_AMA3B2EVB

config BOARD
	default "ama3b2evb"


config HAS_APOLLO_LIB
	bool "Use apollo SDK"
	default y
	
config UART_0
        bool
	default n
	depends on UART_CONSOLE

config UART_1
        bool
	default n
	depends on SERIAL

endif # BOARD_APOLLO3P
```

## rootkit/boards/arm/ama3b2evb/ama3b2evb_defconfig
```kconfig
# SPDX-License-Identifier: Apache-2.0

# 48MHz system clock
CONFIG_SYS_CLOCK_HW_CYCLES_PER_SEC=48000000
CONFIG_SYS_CLOCK_TICKS_PER_SEC=100

CONFIG_SERIAL=n

# console
CONFIG_CONSOLE=n
CONFIG_UART_CONSOLE=n

# enable pinmux
CONFIG_PINMUX=n

# enable GPIO
CONFIG_GPIO=n

# clock configuration
CONFIG_CLOCK_CONTROL=n


# ARM Options
CONFIG_GEN_ISR_TABLES=y
CONFIG_GEN_IRQ_VECTOR_TABLE=y
CONFIG_ARM_MPU=y
CONFIG_MPU_STACK_GUARD=y
CONFIG_MAIN_STACK_SIZE=4096
CONFIG_IDLE_STACK_SIZE=1024
CONFIG_ISR_STACK_SIZE=4096
CONFIG_TEST_EXTRA_STACKSIZE=0
CONFIG_SYSTEM_WORKQUEUE_STACK_SIZE=4096

# General Architecture Options
CONFIG_HW_STACK_PROTECTION=y
#CONFIG_USERSPACE=y
CONFIG_DYNAMIC_INTERRUPTS=y

# Moudles
#CONFIG_GUIX=y
#CONFIG_RGB565_SWAP_BYTEORDER=y
#CONFIG_GUIX_USER_MODE=y

# Device driver
#CONFIG_APOLLO3P_DEVICE=y
CONFIG_SERIAL=y
CONFIG_UART_APOLLO3P=y
CONFIG_CONSOLE=y
CONFIG_UART_CONSOLE=y
#CONFIG_UART_CONSOLE_ON_DEV_NAME="UART_0"
CONFIG_TIMER=y

CONFIG_GPIO=y
CONFIG_GPIO_APOLLO3P=y

CONFIG_I2C=y
CONFIG_I2C_APOLLO3P=y

#CONFIG_LCD=y
#CONFIG_LCD_APOLLO3P=y

#CONFIG_TOUCH_PANEL=y
#CONFIG_TP_APOLLO3P=y

#CONFIG_MSPI_APOLLO3P=y
#CONFIG_APOLLO3P_MSPI1=y

#CONFIG_GUI_GPIO_KEY=y

# SPI Drivers
CONFIG_SPI_APOLLO3P=y
CONFIG_SPI=y

# Flash Device
#CONFIG_APOLLO_MSPI_NOR=y

#CONFIG_USE_SEGGER_RTT=y

# Sensors
#CONFIG_LIS2DH=y

# Subsystem
CONFIG_SHELL=y
#CONFIG_UART_SHELL_ON_DEV_NAME="UART_0"
CONFIG_LOG=y


# Bluetooth
CONFIG_BT=y
CONFIG_BT_LOG_LEVEL_ERR=y
CONFIG_BT_PERIPHERAL=y
CONFIG_BT_HCI_ACL_FLOW_CONTROL=n
CONFIG_BT_HRS=y
CONFIG_BT_BAS=y
CONFIG_BT_DIS=y

CONFIG_BT_SMP=y
CONFIG_BT_ECC=y

#CONFIG_BT_RX_BUF_COUNT=16
#CONFIG_BT_RX_BUF_LEN=320
CONFIG_BT_HCI_TX_STACK_SIZE=2048
CONFIG_BT_HCI_TX_STACK_SIZE_WITH_PROMPT=y

CONFIG_BT_DEVICE_NAME="Zephyr-HR"
CONFIG_BT_DEVICE_APPEARANCE=833

CONFIG_BT_L2CAP_TX_BUF_COUNT=6
CONFIG_BT_L2CAP_TX_FRAG_COUNT=4
#CONFIG_BT_L2CAP_RX_MTU=320
CONFIG_BT_L2CAP_TX_MTU=320

CONFIG_BT_GATT_CLIENT=y


# General Kernel Options
CONFIG_MULTITHREADING=y
CONFIG_NUM_COOP_PRIORITIES=16
CONFIG_NUM_PREEMPT_PRIORITIES=15
CONFIG_MAIN_THREAD_PRIORITY=0
CONFIG_PRIORITY_CEILING=0
CONFIG_NUM_METAIRQ_PRIORITIES=0
CONFIG_THREAD_STACK_INFO=y
CONFIG_THREAD_CUSTOM_DATA=y
CONFIG_ERRNO=y
CONFIG_SCHED_MULTIQ=y
CONFIG_WAITQ_DUMB=y

# Kernel Debugging and Metrics
CONFIG_INIT_STACKS=y
CONFIG_BOOT_DELAY=0
CONFIG_THREAD_MONITOR=y
CONFIG_THREAD_NAME=y
CONFIG_THREAD_MAX_NAME_LEN=32

# Work Queue Options
CONFIG_SYSTEM_WORKQUEUE_PRIORITY=-1

#CONFIG_TICKLESS_IDLE=y
#CONFIG_TICKLESS_IDLE_THRESH=3
CONFIG_TICKLESS_KERNEL=y

#Power Manage
CONFIG_PM=y
CONFIG_PM_POLICY_RESIDENCY=y
#CONFIG_PM_DEVICE_IDLE=y
```

## rootkit/boards/arm/apollo3p/Kconfig.board
```kconfig
# APOLLO3P board configuration

config BOARD_APOLLO3P
	bool "APOLLO3P Development Board"
	depends on SOC_APOLLO3P
	
config BOARD_AMA3B2_EVB
	bool "APOLLO3P AMA3B2EVB"
	depends on SOC_APOLLO3P
```

## rootkit/boards/arm/apollo3p/Kconfig.defconfig
```kconfig
# SPDX-License-Identifier: Apache-2.0

if BOARD_APOLLO3P || BOARD_AMA3B2_EVB

config BOARD
	default "apollo3p"


config HAS_APOLLO_LIB
	bool "Use apollo SDK"
	default y
	
config UART_0
        bool
	default n
	depends on UART_CONSOLE

config UART_1
        bool
	default n
	depends on SERIAL

endif # BOARD_APOLLO3P
```

## rootkit/boards/arm/iwatchv0/Kconfig.board
```kconfig
# APOLLO3P board configuration

config BOARD_IWATCHV0
	bool "APOLLO3P IWATCHV0"
	depends on SOC_APOLLO3P
```

## rootkit/boards/arm/iwatchv0/Kconfig.defconfig
```kconfig
# SPDX-License-Identifier: Apache-2.0

if BOARD_IWATCHV0

choice 
prompt "Board Patch"
config BOARD_PATCH_NONE
  bool "iwatch-v0 without patch"
  
config BOARD_PATCH_V0
  bool "iwatch-v0 small-board patch"
endchoice

config BOARD
	default "ama3b2evb"

config HAS_APOLLO_LIB
	bool "Use apollo SDK"
	default y
	
config UART_0
        bool
	default n
	depends on UART_CONSOLE

config UART_1
        bool
	default n
	depends on SERIAL

endif # BOARD_IWATCHV0
```

## rootkit/components/Kconfig
```kconfig
# Components menu
menuconfig GUIX
	bool "GUIX for zephyr"
	help
	  Enable options for GUIX.
if GUIX
  rsource "gui/Kconfig"
endif

menuconfig XMODEM
	bool "xmodem"
	default n
	help
	  Enable options for xmodem

rsource "stp/Kconfig"
rsource "protobuf-c/Kconfig"
rsource "services/Kconfig"
rsource "motion/Kconfig"
rsource "cm_backtrace/Kconfig"
rsource "ble/Kconfig"
```

## rootkit/components/ble/Kconfig
```kconfig
# BLE menu

menuconfig BLE_COMPONENT
    bool "Bluetooth"
    depends on !BT
    
if BLE_COMPONENT

comment "BLE thread options"

config BLE_THREAD_STACK
  int "BLE thread stack size"
  default 4096
  
config BLE_THREAD_PRIO
  int "BLE thread priority"
  default 10
  
config BLE_USERSPACE
  bool "BLE run into user mode"
  depends on USERSPACE
  
config NUMBER_EVENT_HANDLERS
  int "Maximum number of event handlers per task"
  range 9 32
  default 9
  
config BLE_ASSERT
  bool "Enable assert for BLE stack"
  
rsource "ble-host/sources/Kconfig"
rsource "ble-profiles/sources/Kconfig"

endif
    
```

## rootkit/components/ble/ble-profiles/sources/profiles/Kconfig
```kconfig
# BLE profiles

menu "Profiles"

config BLE_PROFILES_ATPS
	bool "atps profile"
	default y
	
config BLE_PROFILES_BAS
	bool "bas profile"
	default y

config BLE_PROFILES_BLPC
	bool "blpc profile"
	default y

config BLE_PROFILES_BLPS
	bool "blps profile"
	default y

config BLE_PROFILES_CPP
	bool "cpp profile"
	default y

config BLE_PROFILES_CSCP
	bool "cscp profile"
	default y

config BLE_PROFILES_DIS
	bool "dis profile"
	default y

config BLE_PROFILES_FMPL
	bool "fmpl profile"
	default y

config BLE_PROFILES_GAP
	bool "gap profile"
	default y

config BLE_PROFILES_GATT
	bool "gatt profile"
	default y

config BLE_PROFILES_GLPC
	bool "glpc profile"
	default y

config BLE_PROFILES_GLPS
	bool "glps profile"
	default y

config BLE_PROFILES_HID
	bool "hid profile"
	default y

config BLE_PROFILES_HRPC
	bool "hrpc profile"
	default y

config BLE_PROFILES_HRPS
	bool "hrps profile"
	default y

config BLE_PROFILES_HTPC
	bool "htpc profile"
	default y

config BLE_PROFILES_HTPS
	bool "htps profile"
	default y

config BLE_PROFILES_PASPC
	bool "paspc profile"
	default y

config BLE_PROFILES_PLXPC
	bool "plxpc profile"
	default y

config BLE_PROFILES_PLXPS
	bool "plxps profile"
	default y

config BLE_PROFILES_RSCP
	bool "rspc profile"
	default y

config BLE_PROFILES_SCPPS
	bool "scpps profile"
	default y

config BLE_PROFILES_SENSOR
	bool "sensor profile"
	default y

config BLE_PROFILES_TIPC
	bool "tipc profile"
	default y

config BLE_PROFILES_UDSC
	bool "udsc profile"
	default y

config BLE_PROFILES_URIBEACON
	bool "uribeacon profile"
	default y

config BLE_PROFILES_WDXC
	bool "wdxc profile"
	default y

config BLE_PROFILES_WDXS
	bool "wdxs profile"
	default y

config BLE_PROFILES_WPC
	bool "wpc profile"
	default y

config BLE_PROFILES_WSPC
	bool "wspc profile"
	default y

config BLE_PROFILES_WSPS
	bool "wsps profile"
	default y

endmenu

    
```

## rootkit/components/gui/Kconfig
```kconfig
# Device driver configure menu

choice GUIX_ADAPT_IMPL
prompt "GUIX for zephyr adapt layout"
default GUIX_ZEPHYR_SPIN_BINDING

config GUIX_ZEPHYR_SPIN_BINDING
	bool "GUIX binding-zephyr implement by spin-lock"
	
config GUIX_ZEPHYR_POSIX_BINDING
	bool "GUIX binding-zephyr implement by posix api"
	select PTHREAD_IPC
	
config GUIX_ZEPHYR_KQUEUE_BINDING
	bool "GUIX binding-zephyr implement by kernel queue"
	
endchoice #GUIX_ADAPT_IMPL

config GUIX_USER_MODE
       bool "GUI runs in user mode"
       depends on USERSPACE

config GUIX_THREAD_STACK_SIZE
	int "GUIX thread stack"
	default 4096
	help
	  GUIX thread stack size.

config GUIX_THREAD_PRIORITY
	int "GUIX thread priority"
	default 5
	help
	  GUIX thread priority.
	  
config GUIX_MEMPOOL_SIZE
	int "GUIX memory pool"
	default 0
	help
	  Set the memory pool size for GUIX.
	  
config GUI_SPLIT_BINRES
	bool "GUI split resource files and execute code"
	#depends on GUIX_MEMPOOL_SIZE >= 61440

config RGB565_SWAP_BYTEORDER
	bool "GUI rgb565 driver swap byteorder"

config GUIX_DISABLE_ERROR_CHECKING
	bool "Don't check input paramters for GUI API so that improve speed"
	
```
