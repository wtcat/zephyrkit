## CMakeLists.txt
```
# Application
cmake_minimum_required(VERSION 3.13.1)

include(../cmake/modules.cmake)
find_package(Zephyr REQUIRED HINTS $ENV{ZEPHYR_BASE})
project(netcore)

#=======================
# User extension
#=======================
include(../cmake/extensions.cmake)
include(../cmake/debugger.cmake)

#=======================
# Global include path
#=======================
zephyr_include_directories(.)


#===========================
# Subdirectories and target
#===========================
target_sources(app PRIVATE
  src/main.c
)
collect_link_libraries(applibs app)
target_link_libraries(app PUBLIC ${applibs})
```

## Kconfig
```
#Application


# System
source "Kconfig.zephyr"
```

## prj.conf
```kconfig
CONFIG_MAIN_STACK_SIZE=512
CONFIG_SYSTEM_WORKQUEUE_STACK_SIZE=512
CONFIG_HEAP_MEM_POOL_SIZE=8192

# RPMsg
CONFIG_RPMSG_SERVICE=y
CONFIG_RPMSG_SERVICE_MODE_REMOTE=y

# Bluetooth stack
CONFIG_BT=y
CONFIG_BT_HCI_RAW=y
CONFIG_BT_MAX_CONN=16
CONFIG_BT_CTLR_ASSERT_HANDLER=y
CONFIG_BT_HCI_RAW_RESERVE=1


CONFIG_LOG=y

CONFIG_ASSERT=y
CONFIG_DEBUG_INFO=y
CONFIG_EXCEPTION_STACK_TRACE=y

#User library
CONFIG_USER_LIBRARIES=y
CONFIG_RPMSG_HCI_REMOTE=y
```

## src/main.c
```c
#include <stdint.h>
#include <bluetooth/controller.h>
#include "ipc/rpmsg_hci.h"

int main(void) {
    uint8_t mac[] = {0xa0, 0xb1, 0xc2, 0x01, 0x02, 0x03};
    bt_ctlr_set_public_addr(mac);
#ifdef COFNIG_RPMSG_HCI_RX_API
    bt_rpmsg_hci_rx_loop();
#endif
    return 0;
}
```
