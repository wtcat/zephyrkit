## rootkit/dts/bindings/sensor/cellwise,cw6305.yaml
```yaml
description: |
    CELLWISE CW6305 magnetic accessed through I2C bus

compatible: "cellwise,cw6305"

include: i2c-device.yaml

properties:
    int-gpios:
      type: phandle-array
      required: false
      description: extern interrupt input
  
```

## rootkit/dts/bindings/sensor/memsic,mmc5603.yaml
```yaml
description: |
    MEMSIC MMC5603 magnetic accessed through I2C bus

compatible: "memsic,mmc5603"

include: i2c-device.yaml

properties:
    pwr-gpios:
      type: phandle-array
      required: false
      description: Power control pin
        This pin defaults to active high.
```

## rootkit/dts/bindings/serial/ambiq,apollo3p-uart.yaml
```yaml
description: APOLLO3P UART

compatible: "ambiq,apollo3p-uart"

include: uart-controller.yaml

properties:
    reg:
      required: true

    interrupts:
      required: true

    parity:
      required: false
      type: int
      description: Configures the parity of the adapter. Value 0 for none, 1 for odd and 2 for even parity.
      default: 0
```

## rootkit/dts/bindings/spi/ambiq,apollo3p-mspi.yaml
```yaml
description: APOLLO3P MSPI controller

compatible: "ambiq,apollo3p-mspi"

include: spi-controller.yaml

properties:
    reg:
      required: true

    interrupts:
      required: true
```

## rootkit/dts/bindings/spi/ambiq,apollo3p-spi.yaml
```yaml
description: APOLLO3P SPI controller

compatible: "ambiq,apollo3p-spi"

include: spi-controller.yaml

properties:
    reg:
      required: true

    interrupts:
      required: true
```

## rootkit/dts/bindings/timer/ambiq,apollo3p-timers.yaml
```yaml
# SPDX-License-Identifier: Apache-2.0

description: APOLLO3P timers

compatible: "ambiq,apollo3p-timers"

include: base.yaml

properties:
    label:
      required: true

    reg:
      required: true

    clocks:
      required: false

    interrupts:
      required: false
      
    clock_source:
        type: array
        description: register space
        required: false
```

## rootkit/init/Kconfig
```kconfig
menuconfig  USER_SYSTEM_INIT
  bool "User component initialize"

if USER_SYSTEM_INIT

config USER_FS_MOUNT
  bool "Mount filesystem to disk"
  depends on FILE_SYSTEM
endif #USER_SYSTEM_INIT
```

## rootkit/lib/cm_backtrace/Kconfig
```kconfig
menuconfig CORTEXM_BACKTRACE
  bool "Enable stack backtrace for cortex-m"
  depends on CPU_CORTEX_M
  select EXTRA_EXCEPTION_INFO

if CORTEXM_BACKTRACE
config CM_BACKTRACE_DUMPSTACK
    bool "Dump thread stack"

config CM_BACKTRACE_ASSERT
    bool "Enable assert interface"

endif #CORTEXM_BACKTRACE
```

## rootkit/lib/protobuf-c/Kconfig
```kconfig
menuconfig PROTOBUF
  bool "Enable protobuf framework"

if PROTOBUF

config PROTOBUF_HEAP
  int "Configure heap size for protobuf"
  default 2048

endif
```

## rootkit/lib/rpmsg_hci/Kconfig
```kconfig
menuconfig RPMSG_HCI_REMOTE
    bool "RPMsg HCI driver remote node"
    select RPMSG_SERVICE
 #   select RPMSG_SERVICE_MODE_REMOTE
    select BT
    select BT_HCI_RAW
    select BT_CTLR_ASSERT_HANDLER
    help
      Bluetooth controller hci driver implement by RPMsg

if RPMSG_HCI_REMOTE
config RPMSG_HCI_ENDPOINT_NAME
    string "RPMsg HCI remote endpoint name"
    default "nrf_bt_hci"

config RPMSG_HCI_SMALL_FOOTPRINT
    bool "Small memory cost"
    default y

config RPMSG_HCI_RX_API
    bool "Export data receive API"

endif #RPMSG_HCI_REMOTE
      
```

## rootkit/lib/services/Kconfig
```kconfig
#Service

menuconfig SERVICE
  bool "Application service"
  
if SERVICE

config MAGNET_SVR
	bool "Magnetic sensor service"
	
	
endif
```

## rootkit/soc/arm/ambiq_apollo3p/Kconfig
```kconfig
config SOC_FAMILY_APOLLO
	bool

if SOC_FAMILY_APOLLO

config SOC_FAMILY
	string
	default "ambiq_apollo3p"

endif # SOC_FAMILY_APOLLO
```

## rootkit/soc/arm/ambiq_apollo3p/Kconfig.defconfig
```kconfig
# SPDX-License-Identifier: Apache-2.0
if SOC_APOLLO3P

config SOC
    default "ambiq_apollo3p"

config NUM_IRQS
	default 34

config APOLLO3_STIMER
	bool
	default y

config CORTEX_M_SYSTICK
	default n

config FLASH_LOAD_OFFSET
	default 0xc000 if !USE_DT_CODE_PARTITION
endif #SOC_APOLLO3P
```

## rootkit/soc/arm/ambiq_apollo3p/Kconfig.soc
```kconfig
config SOC_APOLLO3P
	bool "APOLLO3P Series MCU"
	select ARM
	select CPU_CORTEX_M4
	select CPU_CORTEX_M_HAS_DWT
	select CPU_HAS_FPU
	select SOC_FAMILY_APOLLO
	select CPU_HAS_ARM_MPU
	select HAS_SWO
        select HAS_APOLLO_LIB
        select ARCH_HAS_CUSTOM_BUSY_WAIT
        select ARMV7_M_ARMV8_M_MAINLINE
        select HAS_SEGGER_RTT
	help
	  Enable support for APOLLO3P MCU series
```

## rootkit/subsys/Kconfig
```kconfig
rsource "blkdev/Kconfig"

rsource "bluetooth/Kconfig"

rsource "dfu/Kconfig"

rsource "esb/Kconfig"

rsource "pcd/Kconfig"

rsource "net/Kconfig"

rsource "nfc/Kconfig"

rsource "event_manager/Kconfig"

rsource "profiler/Kconfig"

rsource "spm/Kconfig"

rsource "fw_info/Kconfig"

rsource "debug/Kconfig"

rsource "shell/Kconfig"

# rsource "mpsl/Kconfig"

rsource "nrf_rpc/Kconfig"

rsource "zigbee/Kconfig"

rsource "mgmt/fmfu/Kconfig"

rsource "caf/Kconfig"

rsource "ieee802154/Kconfig"
```

## rootkit/subsys/blkdev/Kconfig
```kconfig
menuconfig BDBUF
    bool "The Block Device Buffer Management"
    help
      The Block Device Buffer Management implements a cache between the disk
      devices and file systems.  The code provides read-ahead and write queuing to
      the drivers and fast cache look-up using an AVL tree.

if BDBUF

config BDBUF_TRACE
    bool "Enable block device buffer trace log"
    default n

config BDBUF_CACHE_MEMORY_SIZE
    hex "The size of memory allocated to the cache"
    default 0x4000

config BDBUF_BUFFER_MIN_SIZE
    int "The minimum size of buffers"
    default 512

config BDBUF_BUFFER_MAX_SIZE
    int "The maximum size of buffers"
    default 4096

config BDBUF_MAX_WRITE_BLOCKS
    int "The maximum number of blocks to write at once"
    default 16

config BDBUF_SWAPOUT_TASK_PRIORITY
    int "Swap-out task priority"
    range 0 31
    default 15

config BDBUF_TASK_STACK_SIZE
    int "Task stack size for swap-out and worker tasks"
    default 512
    
config BDBUF_MAX_READ_AHEAD_BLOCKS
    int "The maximum read-ahead blocks"
    default 0
    help
      The value for the maximum read-ahead blocks disables the read-ahead
      feature.

config BDBUF_SWAPOUT_TASK_SWAP_PERIOD
    int "Swap-out task swap period in milli seconds"
    default 250

config BDBUF_SWAPOUT_TASK_BLOCK_HOLD
    int "Swap-out task block hold time in milli seconds"
    default 1000

config BDBUF_SWAPOUT_WORKER_TASKS
    int "The maximum swap-out worker tasks"
    range 0 4
    default 0

config BDBUF_SWAPOUT_WORKER_TASK_PRIORITY
    int "Swap-out worker task priority"
    default BDBUF_SWAPOUT_TASK_PRIORITY

config BDBUF_READ_AHEAD_TASK_PRIORITY
    int "Read-ahead task priority"
    default BDBUF_SWAPOUT_TASK_PRIORITY

config BDBUF_AVL_MAX_HEIGHT
    int "The height of AVL tree"
    range 8 32
    default 32
endif #BDBUF
```

## rootkit/subsys/bluetooth/services/Kconfig
```kconfig
menu "Bluetooth Services"

config BT_CUSTOM_SERVICES
	bool
	help
	  Common Bluetooth GATT Services support modules

rsource "Kconfig.nus"
#rsource "Kconfig.nus_client"

endmenu
```

## rootkit/subsys/bluetooth/services/Kconfig.gatts_client
```kconfig
#
# Copyright (c) 2021 Nordic Semiconductor ASA
#
# SPDX-License-Identifier: LicenseRef-Nordic-5-Clause
#

menuconfig BT_GATTS_CLIENT
	bool "Generic Attribute Profile Service client"
	select BT_NRF_SERVICES
	help
	  Enable Generic Attribute Profile Service client.

if BT_GATTS_CLIENT

module = BT_GATTS_CLIENT
module-str = GATT Service Client
source "${ZEPHYR_BASE}/subsys/logging/Kconfig.template.log_config"

endif # BT_GATTS_CLIENT
```

## rootkit/subsys/bluetooth/services/Kconfig.nus_client
```kconfig
#
# Copyright (c) 2019 Nordic Semiconductor ASA
#
# SPDX-License-Identifier: LicenseRef-BSD-5-Clause-Nordic
#

menuconfig BT_NUS_CLIENT
	bool "Custom UART service client"
	select BT_CUSTOM_SERVICES
	help
	  Enable BLE GATT Custom UART service client.

if BT_NUS_CLIENT

module = BT_NUS_CLIENT
module-str = NUS Client
source "${ZEPHYR_BASE}/subsys/logging/Kconfig.template.log_config"

endif # BT_NUS_CLIENT
```

## rootkit/subsys/nvs/Kconfig
```kconfig
# Non-volatile Storage NVS

# Copyright (c) 2018 Laczen
# SPDX-License-Identifier: Apache-2.0

config NVS_CUSTOM
	bool "Non-volatile Storage"
	help
	  Enable support of Non-volatile Storage.

if NVS_CUSTOM

module = NVS_CUSTOM
module-str = nvs_custom
source "subsys/logging/Kconfig.template.log_config"

endif # NVS_CUSTOM
```

## rootkit/subsys/setting/Kconfig
```kconfig
menuconfig SETTING_USE_NVS_CUSTOM
	bool "setting use custom Non-volatile Storage"
    depends on SETTINGS
	help
	  Enable support of Non-volatile Storage.

if SETTING_USE_NVS_CUSTOM
config SETTINGS_NVS_SECTOR_SIZE_MULT
	int "Sector size of the NVS settings area"
	default 1
	help
	  The sector size to use for the NVS settings area as a multiple of
	  FLASH_ERASE_BLOCK_SIZE.

config SETTINGS_NVS_SECTOR_COUNT
	int "Sector count of the NVS settings area"
	default 512
	help
	  Number of sectors used for the NVS settings area
endif
```
