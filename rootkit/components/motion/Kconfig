## rootkit/components/stp/Kconfig
```kconfig
menuconfig STP
  bool "Enable simple transmit protocol"
  select PROTOBUF
  
if STP
choice
prompt "STP Driver"
config STP_BT
  bool "STP bluetooth driver"
  
config STP_UART
  bool "STP uart driver"
  
config STP_LOOPBACK
  bool "STP LOOPBACK driver"
endchoice

config STP_UART_DEV
  string "STP UART device name"
  default "UART_0"
  depends on STP_UART

config STP_RBTREE
  bool "Use RB-tree match target node for STP protocol"

config STP_DRIVER_THREAD_STACK_SIZE
  int 
  range 1024 4096
  default 1024 if STP_UART
  default 2048 if STP_LOOPBACK
  default 4096
  

config STP_OTA
  bool "OTA base STP protocol"
  
if STP_OTA
module = STP_OTA
module-str = STP_OTA
source "subsys/logging/Kconfig.template.log_config"
endif #STP_OTA

module = STP_APP
module-str = STP_APP
source "subsys/logging/Kconfig.template.log_config"

endif #STP
```

## rootkit/debugger/Kconfig
```kconfig
menuconfig CORTEXM_DEBUGGER
  bool "Enable debug component for Cortex-M"
  depends on CPU_CORTEX_M
  select EXTRA_EXCEPTION_INFO

if CORTEXM_DEBUGGER

config CM_WATCHPOINT
  bool "Enable data watchpoint"
  default y

config CM_BACKTRACE
  bool "Enable backtrace for call stack"
  default y

config CM_BACKTRACE_DUMPSTACK
  bool "Dump thread stack"

config CM_BACKTRACE_ASSERT
  bool "Enable assert interface"

config CM_UNWIND_BACKTRACE
  bool "Enable unwind backtrace for cortext"

endif #CORTEXM_DEBUGGER
```

## rootkit/drivers/Kconfig
```kconfig
# Device driver configure menu

rsource "adc/Kconfig"
rsource "serial/Kconfig"
rsource "gpio/Kconfig"
rsource "i2c/Kconfig"
rsource "misc/Kconfig"
rsource "spi/Kconfig"
rsource "flash/Kconfig"
rsource "bluetooth/Kconfig"
rsource "timer/Kconfig"
rsource "display/Kconfig"
rsource "pwm/Kconfig"
rsource "led/Kconfig"
rsource "kscan/Kconfig"
rsource "sensor/Kconfig"
```

## rootkit/drivers/display/Kconfig
```kconfig
# Display drivers

# Copyright (c) 2017 Intel Corporation
# SPDX-License-Identifier: Apache-2.0

menuconfig RM69330
	bool "RM69330 display driver"
	#depends on MSPI
	help
	  Enable driver for RM69330 display driver.

choice RM69330_PIXEL_FORMAT
	prompt "Color pixel format"
	default RM69330_RGB565
	depends on RM69330
	help
	  Specify the color pixel format for the RM69330 display controller.

config RM69330_RGB888
	bool "RGB888"

config RM69330_RGB565
	bool "RGB565"

endchoice
```

## rootkit/drivers/flash/Kconfig
```kconfig
menu "Flash Device"

config APOLLO_MSPI_NOR
  bool "Apollo mspi nor-flash"
  select MSPI_APOLLO3P
  help
    Flash device model is mx25u512g or mx25u256

if APOLLO_MSPI_NOR
choice FLASH_DRV_CHOICE
  prompt "flash driver"
  default MX25U256

config MX25U256
	bool "MX25U256 select"
	help
	  This option select MX25U256

config MX25U512
	bool "MX25U512 select"
	help
	  This option select MX25U512
endchoice
endif

menuconfig  APOLLO_SOC_FLAH
	bool "apollo3 flash driver"
	select FLASH_HAS_PAGE_LAYOUT
	select FLASH_HAS_DRIVER_ENABLED
	default y
	help
	  Enable options for soc flash drivers.

if APOLLO_SOC_FLAH
  #rsource "Kconfig.apoolo3p_soc_flash"
endif

config APOLLO_PSRAM
  bool "APS1604 PSRAM"

endmenu
```

## rootkit/drivers/gpio/Kconfig.apollo3p
```kconfig
config GPIO_APOLLO3P
	bool "APOLLO3P GPIO driver"
	help
	  This option enables the GPIO driver for APOLLO3P
```

## rootkit/drivers/i2c/Kconfig
```kconfig
# I2C driver configure options

menuconfig I2C
		bool "I2C Drivers"
		help 
		  Enable options for I2C driver
		  
if I2C
rsource "Kconfig.apollo3p"

endif #I2C
```

## rootkit/drivers/kscan/Kconfig.cyttsp5
```kconfig
menuconfig KSCAN_CYTTSP5
	bool "CYTTSP5 capacitive touch panel driver"
	depends on I2C
	help
	  Enable driver for multiple Focaltech capacitive touch panel
	  controllers. This driver should support CYTTSP5.

if KSCAN_CYTTSP5

config KSCAN_CYTTSP5_INTERRUPT
	bool "Enable interrupt"
    default y
	help
	  Enable interrupt support (requires GPIO).

config KSCAN_CYTTSP5_THREAD_PRIO
	int "CYTTSP5 thread prio"
	default 3
	help
	  Number of sectors used for the NVS settings area

endif # KSCAN_FT5336
```

## rootkit/drivers/misc/Kconfig
```kconfig
# GPIO driver configuration options

menuconfig MISC
	bool "No-standard driver"
	help
	  Enable options for MISC driver.

if MISC
comment "MISC Drivers"

rsource "Kconfig.key"
rsource "Kconfig.ite7259"
rsource "Kconfig.cyttsp5"
rsource "Kconfig.lcd"
rsource "Kconfig.mspi"

endif # MISC
```

## rootkit/drivers/misc/Kconfig.cyttsp5
```kconfig
menuconfig TOUCH_CYTTSP5
	bool "TOUCH_CYTTSP5 Drivers"
	help
	  Enable options for touch-panel driver.

if TOUCH_CYTTSP5
comment "cyttsp5 Drivers"

config TP_CYTTSP5_APOLLO3P
	bool "cyttsp5 for apollo3p driver"
	help
	  This option enables the touch-panel driver for APOLLO3P

endif # TOUCH_PANEL
```

## rootkit/drivers/misc/Kconfig.lcd
```kconfig
menuconfig LCD
	bool "LCD Drivers"
	help
	  Enable options for LCD driver.

if LCD
comment "LCD Drivers"

choice LCD_DRV_CHOICE
  prompt "lcd driver"
  default LCD_RM69330

config LCD_RM69330
	bool "RM69330 for APOLLO3P driver"
	help
	  This option enables the LCD driver for APOLLO3P

config LCD_RM69092
	bool "RM69092 for APOLLO3P driver"
	help
	  This option enables the LCD driver for APOLLO3P

endchoice




config LCD_DOUBLE_BUFFER
       bool "Enable double buffer for LCD driver"

endif # LCD
```

## rootkit/drivers/misc/Kconfig.rm6903
```kconfig
menuconfig LCD
	bool "LCD Drivers"
	help
	  Enable options for LCD driver.

if LCD
comment "LCD Drivers"

config LCD_APOLLO3P
	bool "RM6903 for APOLLO3P driver"
	help
	  This option enables the LCD driver for APOLLO3P
	 
config LCD_DOUBLE_BUFFER
       bool "Enable double buffer for LCD driver"
	  
endif # LCD
```

## rootkit/drivers/sensor/Kconfig
```kconfig
# Sensor configuration options

# Copyright (c) 2016 Intel Corporation
# SPDX-License-Identifier: Apache-2.0

menuconfig SENSOR
	bool "Sensor Drivers"
	help
	  Include sensor drivers in system config

if SENSOR

comment "Device Drivers"

rsource "mmc5603/Kconfig"
rsource "icm42607/Kconfig"
#rsource "pah8112/Kconfig"
rsource "cw6305/Kconfig"
rsource "gh3011/Kconfig"

rsource "bh1749/Kconfig"
rsource "sensor_sim/Kconfig"
rsource "pmw3360/Kconfig"
rsource "paw3212/Kconfig"

endif # SENSOR
```

## rootkit/drivers/sensor/cw6305/Kconfig
```kconfig
# charger driver configuration options

menuconfig CW6305
	bool "CW6305 charger driver"
	help
	  Enable options for POWER CHARGER driver.

if CW6305
config CW6305_CURRENT
	int "Charging current"
	range 0  6
	default 1
	help
		Charging current map table as follow
		0 -> 180mA
		1 -> 200mA
		2 -> 220mA
		3 -> 250mA
		4 -> 280mA
		5 -> 300mA
		6 -> 320mA

config CW6305_TEMPERATURE
	int "Charging protect temperature"
	range 0  3
	default 3
	help
		Charging temperature map table as follow
		0 -> 60
		1 -> 80
		2 -> 100
		3 -> 120
endif #CW6305		
```

## rootkit/drivers/sensor/gh3011/Kconfig
```kconfig
menuconfig GH3011
	bool "GH3011 Pulse Oximeter and Heart Rate Sensor"
	depends on I2C

if GH3011
endif
```

## rootkit/drivers/sensor/icm42607/Kconfig
```kconfig
# ICM42607 Six-Axis Motion Tracking device configuration options

# Copyright (c) 2020 TDK Invensense
# SPDX-License-Identifier: Apache-2.0

menuconfig ICM42607
	bool "ICM42607 Six-Axis Motion Tracking Device"
	depends on SPI
	help
	  Enable driver for ICM42607 SPI-based six-axis motion tracking device.

if ICM42607

choice
	prompt "Trigger mode"
	default ICM42607_TRIGGER_GLOBAL_THREAD
	help
	  Specify the type of triggering to be used by the driver.

config ICM42607_TRIGGER_NONE
	bool "No trigger"

config ICM42607_TRIGGER_GLOBAL_THREAD
	bool "Use global thread"
	depends on GPIO
	select ICM42607_TRIGGER

config ICM42607_TRIGGER_OWN_THREAD
	bool "Use own thread"
	depends on GPIO
	select ICM42607_TRIGGER


endchoice

config ICM42607_TRIGGER
	bool

config ICM42607_THREAD_PRIORITY
	int "Thread priority"
	depends on ICM42607_TRIGGER_OWN_THREAD
	default 10
	help
	  Priority of thread used by the driver to handle interrupts.

config ICM42607_THREAD_STACK_SIZE
	int "Thread stack size"
	depends on ICM42607_TRIGGER_OWN_THREAD
	default 1024
	help
	  Stack size of thread used by the driver to handle interrupts.

endif # ICM42607
```

## rootkit/drivers/sensor/pah8112/Kconfig
```kconfig
menuconfig PAH8112
	bool "PAH8112 Pulse Oximeter and Heart Rate Sensor"
	depends on I2C

if PAH8112
endif
```

## rootkit/drivers/serial/Kconfig
```kconfig
# Serial driver configuration options

menuconfig SERIAL
	bool "Serial Drivers"
	help
	  Enable options for serial drivers.

if SERIAL
comment "Serial Drivers"

rsource "Kconfig.apollo3p"

endif # SERIAL
```

## rootkit/drivers/spi/Kconfig
```kconfig
# Serial driver configuration options

menuconfig SPI
	bool "SPI Drivers"
	help
	  Enable options for SPI drivers.

if SPI
comment "SPI Drivers"

rsource "Kconfig.apollo3p"

endif # SERIAL
```

## rootkit/drivers/zephyr/adc/Kconfig
```kconfig
#
# ADC options
#
menuconfig ADC
	bool "ADC drivers"
	# All platforms that implement the ADC driver are now required to
	# provide relevant DTS entries.
	help
	  Enable ADC (Analog to Digital Converter) driver configuration.

if ADC

config ADC_SHELL
	bool "Enable ADC Shell"
	default y
	depends on SHELL
	help
	  Enable ADC Shell for testing.

config ADC_ASYNC
	bool "Enable asynchronous call support"
	select POLL
	help
	  This option enables the asynchronous API calls.


rsource "Kconfig.apollo3p"

endif #ADC
```

## rootkit/drivers/zephyr/adc/Kconfig.apollo3p
```kconfig
config ADC_APOLLO3P
  bool "APOLLO3P ADC driver"
  help
    This option enables the ADC driver for APOLLO3P

if ADC_APOLLO3P
config ADC_CH0
  bool "Enable ADC channel 0"

config ADC_CH1
  bool "Enable ADC channel 1"
  
config ADC_CH2
  bool "Enable ADC channel 2"
  
config ADC_CH3
  bool "Enable ADC channel 3"
  
config ADC_CH4
  bool "Enable ADC channel 4"
  
config ADC_CH5
  bool "Enable ADC channel 5"
  
config ADC_CH6
  bool "Enable ADC channel 6"
  
config ADC_CH7
  bool "Enable ADC channel 7"
endif
```

## rootkit/drivers/zephyr/gpio/Kconfig
```kconfig
# GPIO driver configuration options

menuconfig GPIO
	bool "GPIO Drivers"
	help
	  Enable options for GPIO driver.

if GPIO
comment "GPIO Drivers"

rsource "Kconfig.apollo3p"

endif # SERIAL
```

## rootkit/drivers/zephyr/gps/Kconfig
```kconfig
# GPS Drivers
#
# Copyright (c) 2018-2019 Nordic Semiconductor ASA
#
# SPDX-License-Identifier: LicenseRef-Nordic-5-Clause
#

menuconfig GPS
    bool "GPS Drivers"
    help
      GPS drivers

if GPS
    rsource "gps_sim/Kconfig"
    rsource "nrf9160_gps/Kconfig"
endif
```
