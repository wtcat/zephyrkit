## rootkit/drivers/zephyr/i2c/Kconfig.apollo3p
```kconfig
config I2C_APOLLO3P
	bool "APOLLO3P i2c driver"
	help
	  This option enables the i2c driver for APOLLO3P
```

## rootkit/drivers/zephyr/kscan/Kconfig
```kconfig
menuconfig KSCAN
	bool "Keyboard Scan Drivers"
	help
	  Include Keyboard scan drivers in system config.

if KSCAN

rsource "./Kconfig.cyttsp5"


config GPIO_KEYS
  bool "Standard gpio-key driver"

endif
```

## rootkit/drivers/zephyr/led/Kconfig
```kconfig
# MOTOR PWM driver configuration options

config MOTOR_PWM
	bool "MOTOR PWM Drivers"
	help
	  Enable options for MOTOR PWM driver.
```

## rootkit/drivers/zephyr/led/Kconfig.apollo3p
```kconfig
config PWM_APOLLO3P
	bool "APOLLO3P PWM driver"
	help
	  This option enables the PWM driver for APOLLO3P
```

## rootkit/drivers/zephyr/misc/Kconfig.ite7259
```kconfig
menuconfig TOUCH_PANEL
	bool "TOUCH-PANEL Drivers"
	help
	  Enable options for touch-panel driver.

if TOUCH_PANEL
comment "TOUCH-PANEL Drivers"

config TP_APOLLO3P
	bool "ITE7259 for apollo3p driver"
	help
	  This option enables the touch-panel driver for APOLLO3P

endif # TOUCH_PANEL
```

## rootkit/drivers/zephyr/misc/Kconfig.mspi
```kconfig
menuconfig MSPI_APOLLO3P
  bool "Apollo3p MSPI bus device driver"
  
if MSPI_APOLLO3P
module = MSPI
module-str = mspi
source "subsys/logging/Kconfig.template.log_config"

config APOLLO3P_MSPI0
  bool "MSPI_0"
  
config APOLLO3P_MSPI1
  bool "MSPI_1"

config APOLLO3P_MSPI2
  bool "MSPI_2"
  
endif
  
```

## rootkit/drivers/zephyr/pwm/Kconfig
```kconfig
# PWM driver configuration options

menuconfig PWM
	bool "PWM Drivers"
	help
	  Enable options for PWM driver.

if PWM
comment "PWM Drivers"

rsource "Kconfig.apollo3p"

endif # PWM
```

## rootkit/drivers/zephyr/sensor/Kconfig
```kconfig
# Sensor configuration options

# Copyright (c) 2016 Intel Corporation
# SPDX-License-Identifier: Apache-2.0

menuconfig SENSOR
	bool "Sensor Drivers"
	help
	  Include sensor drivers in system config
if SENSOR
	rsource "mmc5603/Kconfig"
	rsource "cw6305/Kconfig"
	rsource "bh1749/Kconfig"
endif # SENSOR
```

## rootkit/drivers/zephyr/sensor/mmc5603/Kconfig
```kconfig
menuconfig MMC5603
	bool "MMC5603 I2C magnetic sensor driver"
	depends on I2C
	help
	  Enable driver for MMC5603 magnetic sensor driver

if MMC5603
config MMC5603_ENABLE_TEMP
	bool "Enable temperature"
	help
	  Enable/disable temperature

config MMC5603_ODR
	int "Magnetic Output data rate frequency"
	range 0 4
	default 1
	help
	  Specify the default accelerometer output data rate expressed in
	  samples per second (Hz).
	  0: ODR selected at runtime
	  1: 75Hz
	  2: 150Hz
	  3: 255Hz
	  4: 1000Hz

endif # MMC5603
```

## rootkit/drivers/zephyr/serial/Kconfig.apollo3p
```kconfig
config UART_APOLLO3P
	bool "APOLLO3P serial driver"
	select SERIAL_HAS_DRIVER
	select SERIAL_SUPPORT_INTERRUPT
	help
	  This option enables the UART driver for APOLLO3P
```

## rootkit/drivers/zephyr/spi/Kconfig.apollo3p
```kconfig
menuconfig SPI_APOLLO3P
  bool "APOLLO3P SPI driver"
  help
    This option enables the SPI driver for APOLLO3P
    
if SPI_APOLLO3P

config SPI_APOLLO3P_INTERRUPT
  bool "Enable SPI interrupt for APOLLO3P"

endif
```

## rootkit/drivers/zephyr/timer/Kconfig
```kconfig
# Timer driver configuration options

# Copyright (c) 2014-2015 Wind River Systems, Inc.
# Copyright (c) 2016 Cadence Design Systems, Inc.
# Copyright (c) 2019 Intel Corp.
# SPDX-License-Identifier: Apache-2.0

menuconfig  TIMER
	bool "TIMER Drivers"
	help
	  Enable options for stimer drivers.

if TIMER
rsource "Kconfig.apollo3_stimer"
endif
```

## rootkit/drivers/zephyr/timer/Kconfig.apollo3_stimer
```kconfig
# STM32 LPTIM configuration options

# Copyright (c) 2019 STMicroelectronics
# SPDX-License-Identifier: Apache-2.0

menuconfig APOLLO3_STIMER
	bool "APOLLO3P Low Power Timer [EXPERIMENTAL]"
	depends on SOC_APOLLO3P
	select TICKLESS_CAPABLE
	default y
	help
	  This module implements a kernel device driver for the LowPower Timer
	  and provides the standard "system clock driver" interfaces.

if APOLLO3_STIMER  ##add private config if need

config APOLLO3_STIMER_BACKUP
  bool "apollo3 stimer compare b enable"
  default y

endif # APOLLO3_STIMER
```

## rootkit/drivers_ext/Kconfig
```kconfig
# Device driver configure menu

menuconfig APOLLO3P_DEVICE_PRIVATE
	bool "Device Drivers private"
	default n
	help
	  Enable options for apollo3p device drivers.


if APOLLO3P_DEVICE_PRIVATE

rsource "counter/Kconfig"

endif #APOLLO3P_DEVICE
```

## rootkit/drivers_ext/counter/Kconfig
```kconfig
# Display drivers

# Copyright (c) 2017 Intel Corporation
# SPDX-License-Identifier: Apache-2.0

menuconfig COUNTER_EXTRA
	default y
	depends on ! COUNTER
	bool "Counter extra Drivers"
	help
	  Enable support for counter and timer.

if COUNTER_EXTRA
module = COUNTER_APOLLO
module-str = counter_apollo
source "subsys/logging/Kconfig.template.log_config"

rsource "Kconfig.apollo3p"

endif # COUNTER_EXTRA
```

## rootkit/drivers_ext/counter/Kconfig.apollo3p
```kconfig
menuconfig COUNTER_RTC_APOLLO3P
	default y
	bool "APOLLO3P Counter RTC driver"
	help
	  Build RTC driver for apollo3p SoCs.


if COUNTER_RTC_APOLLO3P
endif
```

## rootkit/dts/bindings/adc/ambiq,apollo3p-adc.yaml
```yaml
description: AMBIQ ADC node
compatible: "ambiq,apollo3p-adc"
include: adc-controller.yaml
properties:
    reg:
      required: true

    interrupts:
      required: true

    "#io-channel-cells":
      const: 1

io-channel-cells:
    - input
```

## rootkit/dts/bindings/gpio/ambiq,apollo3p-gpio.yaml
```yaml
description: APOLLO3P GPIO node

compatible: "ambiq,apollo3p-gpio"

include: [gpio-controller.yaml, base.yaml]

properties:
    reg:
      required: true

    label:
      required: true

    clocks:
      required: false

    "#gpio-cells":
      const: 2

gpio-cells:
  - pin
  - flags
```

## rootkit/dts/bindings/gpio/gpio-buttons.yaml
```yaml
# Copyright (c) 2018, Linaro Limited
# SPDX-License-Identifier: Apache-2.0

description: GPIO BUTTONS parent node

compatible: "gpio-buttons"

child-binding:
    description: GPIO BUTTONS child node
    properties:
       label:
          required: true
          type: string
          description: Human readable string describing the device (used as device_get_binding() argument)
       gpios:
          type: phandle-array
          required: true
       code:
          type: int
          required: true
          description: GPIO pin code
```

## rootkit/dts/bindings/i2c/ambiq,apollo3p-i2c.yaml
```yaml
description: apollo3p I2C controller

compatible: "ambiq,apollo3p-i2c"

include: i2c-controller.yaml

properties:
    reg:
      required: true

    interrupts:
      required: true
      
    clock-frequency:
      required: true
```

## rootkit/dts/bindings/led/pwm-motors.yaml
```yaml
# Copyright (c) 2018, Linaro Limited
# SPDX-License-Identifier: Apache-2.0

description: PWM MOTORs parent node

compatible: "pwm-motors"

child-binding:
    description: PWM MOTOR child node
    properties:
        pwms:
          type: phandle-array
          required: true

        label:
          required: false
          type: string
          description: Human readable string describing the device (used as device_get_binding() argument)
```

## rootkit/dts/bindings/mtd/gd,mspi-nor.yaml
```yaml
description: GD mspi flash node

compatible: "gd,mspi-nor"


properties:
    label:
      required: true
      type: string
      description: Human readable string describing the device (used as device_get_binding() argument)
```

## rootkit/dts/bindings/pwm/ambiq,apollo3p-pwm.yaml
```yaml
description: AMBIQ PWM

compatible: "ambiq,apollo3p-pwm"

include: [pwm-controller.yaml, base.yaml]

properties:
    reg:
      required: false

    ch0_pin:
      type: int
      required: false
      description: |
        The channel 0 pin to use.
        
    ch1_pin:
      type: int
      required: false
      description: |
        The channel 1 pin to use. 

    "#pwm-cells":
      const: 3

pwm-cells:
  - channel
# period in terms of nanoseconds
  - period
  - flags
```

## rootkit/dts/bindings/rtc/ambiq,apollo3p-rtc.yaml
```yaml
description: APOLLO3P RTC

compatible: "ambiq,apollo3p-rtc"

include: rtc.yaml

properties:
    reg:
      required: true
```
